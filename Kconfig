## Kconfig
```kconfig
choice
    prompt "platform"
    default PLATFORM_NUTTX
    config PLATFORM_NUTTX
        bool "nuttx"
endchoice

config BOARD_PLATFORM
    string
    default "nuttx" if PLATFORM_NUTTX

config BOARD_TOOLCHAIN
    string "Toolchain"
    default ""

config BOARD_ARCHITECTURE
    string "Architecture"
    default ""

menu "platforms"
depends on PLATFORM_NUTTX
source "platforms/Kconfig"
endmenu
```

## boards/flysq/v1/nuttx-config/nsh/defconfig
```kconfig
CONFIG_ARCH="arm"
CONFIG_ARCH_BOARD_CUSTOM=y
CONFIG_ARCH_BOARD_CUSTOM_DIR="../../../../boards/flysq/v1/nuttx-config"
CONFIG_ARCH_BOARD_CUSTOM_DIR_RELPATH=y
CONFIG_ARCH_BOARD_CUSTOM_NAME="flysq"
CONFIG_ARCH_CHIP="stm32"
CONFIG_ARCH_CHIP_STM32=y
CONFIG_ARCH_CHIP_STM32F407ZG=y
```

## platforms/nuttx/Kconfig
```kconfig
choice
	prompt "NuttX platform"
	---help---
		This automatically gets set by the NuttX defconfig
	config ARCH_CHIP_UNSET
		bool "Unset"
	config ARCH_CHIP_STM32H7
		bool "STM32H7"
	config ARCH_CHIP_STM32F7
		bool "STM32F7"
	config ARCH_CHIP_STM32F4
		bool "STM32F4"
	config ARCH_CHIP_IMXRT
		bool "IMXRT"
	config ARCH_CHIP_S32K3XX
		bool "S32K3XX"
	config ARCH_CHIP_RP2040
		bool "RP2040"
endchoice
```
